## lib/Kconfig
```kconfig
# SPDX-FileCopyrightText: 2025 UL Solutions - Software Intensive Systems
#
# SPDX-License-Identifier: Apache-2.0

rsource "ul/Kconfig"
```

## lib/ul/Kconfig
```kconfig
# SPDX-FileCopyrightText: 2025 UL Solutions - Software Intensive Systems
#
# SPDX-License-Identifier: Apache-2.0

menu "UL libraries"

rsource "pkcs11/Kconfig"

endmenu
```

## lib/ul/pkcs11/Kconfig
```kconfig
# SPDX-FileCopyrightText: 2025 UL Solutions - Software Intensive Systems
#
# SPDX-License-Identifier: Apache-2.0

config UL_PKCS11_IMPL
    bool "Support for custom UL PKS library"
    select MBEDTLS
    select MBEDTLS_ENABLE_PSA
    select MBEDTLS_PSA_CRYPTO_C
    select MBEDTLS_PSA_CRYPTO_STORAGE_C if BUILD_WITH_TPM
    imply PSA_WANT_KEY_TYPE_AES
    imply PSA_WANT_ALG_CTR
    imply PSA_WANT_GENERATE_RANDOM
    help
      This option enables the 'custom UL PKS' library
```

## tests/lib/ul/pksc11/integration/testcase.yaml
```yaml
# SPDX-FileCopyrightText: 2025 UL Solutions - Software Intensive Systems
#
# SPDX-License-Identifier: Apache-2.0

common:
  integration_platforms:
  - native_sim
tests:
  pkcs11.integration:
    harness: ztest
```

## tests/lib/ul/pksc11/unit/testcase.yaml
```yaml
# SPDX-FileCopyrightText: 2025 UL Solutions - Software Intensive Systems
#
# SPDX-License-Identifier: Apache-2.0

common:
  type: unit
tests:
  pkcs11.basic.info_logging:
    extra_configs:
      - CONFIG_LOG_DEFAULT_LEVEL=3
  pkcs11.basic.no_logging:
    extra_configs:
      - CONFIG_LOG_DEFAULT_LEVEL=0
```

## west.yml
```yaml
# SPDX-FileCopyrightText: 2025 UL Solutions - Software Intensive Systems
#
# SPDX-License-Identifier: Apache-2.0

manifest:
  self:
    path: zephyr-security-showcase

  remotes:
    - name: ncs
      url-base: https://github.com/nrfconnect

  projects:
    - name: nrf
      repo-path: sdk-nrf
      remote: ncs
      revision: v3.1.0
      clone-depth: 1
      import:
        name-allowlist:
          - cmsis_6
          - hal_nordic
          - mbedtls
          - nrfxlib
          - oberon-psa-crypto
          - trusted-firmware-m
          - zephyr
```
