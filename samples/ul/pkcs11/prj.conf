## CMakeLists.txt
```
# SPDX-FileCopyrightText: 2025 UL Solutions - Software Intensive Systems
#
# SPDX-License-Identifier: Apache-2.0

cmake_minimum_required(VERSION 3.20.0)
find_package(Zephyr REQUIRED HINTS $ENV{ZEPHYR_BASE})

project(ul_pkcs11_app LANGUAGES C)

target_sources(app PRIVATE src/main.c)
```

## sample.yaml
```
# SPDX-FileCopyrightText: 2025 UL Solutions - Software Intensive Systems
#
# SPDX-License-Identifier: Apache-2.0

tests:
  sample.pkcs11:
    integration_platforms:
      - native_sim
      #- nrf7002dk/nrf5340/cpuapp/ns (does not work due to pm_config errors right now)
    tags:
      - ul
      - pkcs11
    harness: console
    harness_config:
      type: multi_line
      ordered: true
      regex:
        - ".*C_Initialize succeeded"
        - ".*C_GenerateKey succeeded"
        - ".*Plaintext: Sample text to be encrypted!"
        - ".*Ciphertext length: 45"
        - ".*Decrypted: Sample text to be encrypted!"
        - ".*successfully finalized"
```

## prj.conf
```kconfig
# SPDX-FileCopyrightText: 2025 UL Solutions - Software Intensive Systems
#
# SPDX-License-Identifier: Apache-2.0

# Enable own PKCS11 implementation to use
CONFIG_UL_PKCS11_IMPL=y

# The Zephyr CMSIS emulation assumes that ticks are ms, currently
CONFIG_SYS_CLOCK_TICKS_PER_SEC=1000

# Some more stack and memory to use for the example
CONFIG_MAIN_STACK_SIZE=4096
CONFIG_HEAP_MEM_POOL_SIZE=4096
CONFIG_REBOOT=y

# Enable logging
CONFIG_CONSOLE=y
CONFIG_LOG=y

# Enable Metadata output for SBOM generation
CONFIG_BUILD_OUTPUT_META=y
```

## boards/native_sim.conf
```kconfig
# SPDX-FileCopyrightText: 2025 UL Solutions - Software Intensive Systems
#
# SPDX-License-Identifier: Apache-2.0

CONFIG_SECURE_STORAGE=y
CONFIG_NVS=y
CONFIG_SETTINGS=y
CONFIG_SETTINGS_NVS=y
CONFIG_FLASH=y
CONFIG_FLASH_MAP=y
```

## boards/nrf7002dk_nrf5340_cpuapp_ns.conf
```kconfig
# SPDX-FileCopyrightText: 2025 UL Solutions - Software Intensive Systems
#
# SPDX-License-Identifier: Apache-2.0

CONFIG_NRF_SECURITY=y

CONFIG_BUILD_WITH_TFM=y

CONFIG_TFM_PARTITION_INTERNAL_TRUSTED_STORAGE=y
CONFIG_TFM_PROFILE_TYPE_MEDIUM=y
```

## src/main.c
```c
/*
 * SPDX-FileCopyrightText: 2025 UL Solutions - Software Intensive Systems
 *
 * SPDX-License-Identifier: Apache-2.0
 */

#include <stddef.h>

#ifdef CONFIG_ARCH_POSIX
#include <posix_board_if.h>
#endif

#include <zephyr/logging/log.h>

#include <external/pkcs11/pkcs11.h>

const int APP_SUCCESS = 0;
const int APP_ERROR = -1;

LOG_MODULE_REGISTER(persistent_key_usage, LOG_LEVEL_INF);

int main(void)
{
    CK_RV rv;
    CK_SESSION_HANDLE session = 0;
    CK_MECHANISM mechanism = {CKM_AES_KEY_GEN, NULL, 0};
    CK_OBJECT_HANDLE key_handle = 0;

    // Init
    rv = C_Initialize(NULL);
    if (rv != CKR_OK)
    {
        LOG_ERR("C_Initialize failed: 0x%lX", rv);
        return APP_ERROR;
    }
    LOG_INF("C_Initialize succeeded");

    // Generate/reuse key
    rv = C_GenerateKey(session, &mechanism, NULL, 0, &key_handle);
    if (rv != CKR_OK)
    {
        LOG_ERR("C_GenerateKey failed: 0x%lX", rv);
        return APP_ERROR;
    }
    LOG_INF("C_GenerateKey succeeded");

    // Encryption test
    CK_BYTE plaintext[] = "Sample text to be encrypted!";
    LOG_INF("Plaintext: %s", plaintext);
    CK_BYTE ciphertext[64];
    CK_ULONG ciphertext_len = sizeof(ciphertext);

    rv = C_EncryptInit(session, NULL, key_handle);
    if (rv != CKR_OK)
    {
        LOG_ERR("C_EncryptInit failed: 0x%lX", rv);
        return APP_ERROR;
    }
    LOG_INF("C_EncryptInit succeeded");

    rv = C_Encrypt(session, plaintext, sizeof(plaintext), ciphertext, &ciphertext_len);
    if (rv != CKR_OK)
    {
        LOG_ERR("C_Encrypt failed: 0x%lX", rv);
        return APP_ERROR;
    }
    LOG_INF("Ciphertext length: %lu", ciphertext_len);

    // Decryption test
    CK_BYTE decrypted[64];
    CK_ULONG decrypted_len = sizeof(decrypted);

    rv = C_DecryptInit(session, NULL, key_handle);
    if (rv != CKR_OK)
    {
        LOG_ERR("C_DecryptInit failed: 0x%lX", rv);
        return APP_ERROR;
    }
    LOG_INF("C_DecryptInit succeeded");

    rv = C_Decrypt(session, ciphertext, ciphertext_len, decrypted, &decrypted_len);
    if (rv != CKR_OK)
    {
        LOG_ERR("C_Dencrypt failed: 0x%lX", rv);
        return APP_ERROR;
    }


    LOG_INF("Decrypted: %s", decrypted);

    // Finalize
    rv = C_Finalize(NULL);
    if (rv != CKR_OK)
    {
        LOG_ERR("C_Finalize failed: 0x%lX", rv);
        return APP_ERROR;
    }

#ifdef CONFIG_ARCH_POSIX
    posix_exit(APP_SUCCESS);
#endif

    return APP_SUCCESS;
}
```
